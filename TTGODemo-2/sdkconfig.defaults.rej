## TTGODemo-2/sdkconfig.defaults.rej
```kconfig
diff a/sdkconfig.defaults b/sdkconfig.defaults	(rejected hunks)
@@ -163,7 +163,7 @@ CONFIG_APPTRACE_LOCK_ENABLE=y
 #
 # Bluetooth
 #
-# CONFIG_BT_ENABLED is not set
+CONFIG_BT_ENABLED=y
 CONFIG_BTDM_CTRL_BR_EDR_SCO_DATA_PATH_EFF=0
 CONFIG_BTDM_CTRL_PCM_ROLE_EFF=0
 CONFIG_BTDM_CTRL_PCM_POLAR_EFF=0
@@ -173,6 +173,12 @@ CONFIG_BTDM_CTRL_BR_EDR_MAX_SYNC_CONN_EFF=0
 CONFIG_BTDM_CTRL_PINNED_TO_CORE=0
 CONFIG_BTDM_BLE_SLEEP_CLOCK_ACCURACY_INDEX_EFF=1
 CONFIG_BT_RESERVE_DRAM=0
+CONFIG_BTDM_CTRL_MODE_BLE_ONLY=n
+CONFIG_BTDM_CTRL_MODE_BR_EDR_ONLY=y
+CONFIG_BTDM_CTRL_MODE_BTDM=n
+CONFIG_BT_CLASSIC_ENABLED=y
+CONFIG_BT_SPP_ENABLED=y
+CONFIG_BT_BLE_ENABLED=n
 # end of Bluetooth
 
 #
@@ -721,8 +727,8 @@ CONFIG_MBEDTLS_SSL_OUT_CONTENT_LEN=4096
 # Certificate Bundle
 #
 CONFIG_MBEDTLS_CERTIFICATE_BUNDLE=y
-CONFIG_MBEDTLS_CERTIFICATE_BUNDLE_DEFAULT_FULL=y
-# CONFIG_MBEDTLS_CERTIFICATE_BUNDLE_DEFAULT_CMN is not set
+# CONFIG_MBEDTLS_CERTIFICATE_BUNDLE_DEFAULT_FULL=n
+CONFIG_MBEDTLS_CERTIFICATE_BUNDLE_DEFAULT_CMN=y
 # CONFIG_MBEDTLS_CERTIFICATE_BUNDLE_DEFAULT_NONE is not set
 # CONFIG_MBEDTLS_CUSTOM_CERTIFICATE_BUNDLE is not set
 # end of Certificate Bundle
```
